## conf/layer.conf
```bitbake
# We have a conf and classes directory, add to BBPATH
BBPATH := "${BBPATH}:${LAYERDIR}"

# We have a recipes directory, add to BBFILES
BBFILES := "${BBFILES} ${LAYERDIR}/recipes-*/*/*.bb \
	        ${LAYERDIR}/recipes-*/*/*.bbappend"

BBFILE_COLLECTIONS += "alix3d3"
BBFILE_PATTERN_alix3d3 := "^${LAYERDIR}/"
BBFILE_PRIORITY_alix3d3 = "6"
```

## conf/machine/alix3d3.conf
```bitbake
#@TYPE: Machine
#@NAME: alix3d3

#@DESCRIPTION: Machine configuration for alix3d3 systems

PREFERRED_PROVIDER_virtual/kernel ?= "linux-yocto"
#PREFERRED_VERSION_linux-yocto ?= "3.4%"
PREFERRED_VERSION_linux-yocto ?= "3.8%"

require conf/machine/include/tune-i586.inc
require conf/machine/include/ia32-base.inc

# FIXME: /  and /home should be in seperate partitions. Look at how we
# can generate hdimage with different partition layout. Change fstab as
# well
IMAGE_FSTYPES = "tar.gz live"

# FIXME: Need to add xorg-video-geode driver.

# now. Look at extensions, should we need all of them?
# 
XSERVER ?= "${XSERVER_IA32_BASE} \
           ${XSERVER_IA32_EXT} \
           ${XSERVER_IA32_VESA} \
           "

# FIXME: write lxfb.mode configuration. We do not use vesafb
APPEND += "video=vesafb vga=0x318"
```
